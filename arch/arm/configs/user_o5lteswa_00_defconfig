## arch/arm/configs/user_o5lteswa_00_defconfig
```kconfig
CONFIG_ARM=y
CONFIG_ARCH_EXYNOS=y
CONFIG_ARCH_EXYNOS3=y
CONFIG_SOC_EXYNOS3475=y
CONFIG_MACH_UNIVERSAL3475=y
CONFIG_CPU_V7=y
CONFIG_SMP=y
CONFIG_NR_CPUS=4
CONFIG_PREEMPT=y
CONFIG_HZ=200
CONFIG_VMSPLIT_3G=y
CONFIG_PAGE_OFFSET=0xC0000000
CONFIG_HIGHMEM=y
CONFIG_ARM_TRUSTZONE=y
# CONFIG_ARM_LPAE is not set
CONFIG_ARM_THUMB=y
CONFIG_VFP=y
CONFIG_VFPv3=y
CONFIG_NEON=y
CONFIG_ARM_AMBA=y
CONFIG_ARM_ERRATA_814220=y
CONFIG_HOTPLUG_CPU=y
CONFIG_EXYNOS5_DYNAMIC_CPU_HOTPLUG=y
CONFIG_AEABI=y
CONFIG_CPU_FREQ=y
CONFIG_CPU_FREQ_DEFAULT_GOV_INTERACTIVE=y
CONFIG_CPU_FREQ_GOV_PERFORMANCE=y
CONFIG_CPU_FREQ_GOV_INTERACTIVE=y
CONFIG_ARM_EXYNOS_CPUFREQ=y
CONFIG_ARM_EXYNOS3475_CPUFREQ=y
CONFIG_CPU_IDLE=y
CONFIG_CPU_IDLE_EXYNOS=y
CONFIG_EXYNOS_IDLE_CLOCK_DOWN=y
# CONFIG_IKCONFIG is not set
# CONFIG_MODULES is not set
CONFIG_KERNEL_GZIP=y
CONFIG_BLK_DEV_INITRD=y
CONFIG_CGROUPS=y
CONFIG_CGROUP_FREEZER=y
CONFIG_CGROUP_CPUACCT=y
CONFIG_CGROUP_SCHED=y
CONFIG_RT_GROUP_SCHED=y
CONFIG_NAMESPACES=y
CONFIG_SUSPEND=y
CONFIG_PM_RUNTIME=y
CONFIG_PM=y
CONFIG_PM_GENERIC_DOMAINS=y
CONFIG_PM_AUTOSLEEP=y
CONFIG_PM_WAKELOCKS=y
CONFIG_HAS_WAKELOCK=y
CONFIG_WAKELOCK=y
CONFIG_DEFERRED_INITCALLS=y
CONFIG_LOG_BUF_SHIFT=17
CONFIG_SLUB=y
CONFIG_SLUB_DEBUG=y
CONFIG_SYSVIPC=y
CONFIG_AUDIT=y
CONFIG_AUDITSYSCALL=y
CONFIG_SPARSE_IRQ=y
CONFIG_NO_HZ=y
CONFIG_HIGH_RES_TIMERS=y
CONFIG_PREEMPT_RCU=y
CONFIG_ZSWAP=y
CONFIG_CMA=y
CONFIG_COMPACTION=y
CONFIG_MIGRATION=y
CONFIG_FLATMEM=y
CONFIG_SECCOMP=y
CONFIG_PERF_EVENTS=y
CONFIG_PROFILING=y
CONFIG_KALLSYMS=y
CONFIG_SHMEM=y
CONFIG_AIO=y
CONFIG_BINFMT_ELF=y
CONFIG_COREDUMP=y
CONFIG_IOSCHED_CFQ=y
CONFIG_EFI_PARTITION=y
CONFIG_MSDOS_PARTITION=y
CONFIG_USE_OF=y
CONFIG_BUILD_ARM_APPENDED_DTB_IMAGE=y
CONFIG_BUILD_ARM_APPENDED_DTB_IMAGE_NAMES="exynos3475-universal3475"
CONFIG_ARM_APPENDED_DTB=y
CONFIG_ARM_ATAG_DTB_COMPAT=y
CONFIG_PLAT_SAMSUNG=y
CONFIG_S5P_PM=y
CONFIG_EXYNOS_ASV=y
CONFIG_EXYNOS3475_BTS=y
CONFIG_CAL_SYS_PWRDOWN=y
CONFIG_EXYNOS_SMC_WRAPPER=y
CONFIG_EXYNOS5_SETUP_MIPIPHY=y
CONFIG_EXYNOS_CORESIGHT=y
CONFIG_EXYNOS_CORESIGHT_PC_INFO=y
CONFIG_SAMSUNG_DMADEV=y
CONFIG_SAMSUNG_GPIOLIB_4BIT=y
CONFIG_SAMSUNG_PRODUCT_SHIP=y
CONFIG_TIMA=y
CONFIG_CP_SECURE_BOOT=y
CONFIG_NET=y
CONFIG_PACKET=y
CONFIG_UNIX=y
CONFIG_INET=y
CONFIG_IPV6=y
CONFIG_NETFILTER=y
CONFIG_ANDROID_PARANOID_NETWORK=y
CONFIG_NF_CONNTRACK=y
CONFIG_NF_NAT=y
CONFIG_IP_NF_IPTABLES=y
CONFIG_IP_NF_FILTER=y
CONFIG_IP_NF_MANGLE=y
CONFIG_BT=y
CONFIG_CFG80211=y
CONFIG_WIRELESS=y
CONFIG_RFKILL=y
CONFIG_DEVTMPFS=y
CONFIG_DEVTMPFS_MOUNT=y
CONFIG_FW_LOADER=y
CONFIG_OF=y
CONFIG_BLK_DEV_LOOP=y
CONFIG_BLK_DEV_RAM=y
CONFIG_REGMAP=y
CONFIG_REGMAP_I2C=y
CONFIG_REGMAP_SPI=y
CONFIG_REGMAP_MMIO=y
CONFIG_EXYNOS7580_MCU_IPC=y
CONFIG_EXYNOS7580_SHM_IPC=y
CONFIG_SEC_MODEM_V1=y
CONFIG_SEC_MODEM_SS310AP=y
CONFIG_LINK_DEVICE_SHMEM=y
CONFIG_UMTS_MODEM_SS310AP=y
CONFIG_VBUS_NOTIFIER=y
CONFIG_USE_MUIC=y
CONFIG_MUIC_NOTIFIER=y
CONFIG_MUIC_UNIVERSAL=y
CONFIG_MUIC_UNIVERSAL_SM5703=y
CONFIG_MUIC_UART_SWITCH=y
CONFIG_SCSI=y
CONFIG_BLK_DEV_SD=y
CONFIG_MD=y
CONFIG_BLK_DEV_DM=y
CONFIG_DM_CRYPT=y
CONFIG_DM_VERITY=y
CONFIG_NETDEVICES=y
CONFIG_TUN=y
CONFIG_PPP=y
CONFIG_WLAN=y
CONFIG_BCM4343=y
CONFIG_BCMDHD_FW_PATH="/system/etc/wifi/bcmdhd_sta.bin"
CONFIG_BCMDHD_NVRAM_PATH="/system/etc/wifi/nvram_net.txt"
CONFIG_BROADCOM_WIFI_RESERVED_MEM=y
CONFIG_INPUT=y
CONFIG_INPUT_EVDEV=y
CONFIG_INPUT_KEYBOARD=y
CONFIG_KEYBOARD_GPIO=y
CONFIG_KEYBOARD_SAMSUNG=y
CONFIG_INPUT_TOUCHSCREEN=y
CONFIG_TOUCHSCREEN_MELFAS_MMS438=y
CONFIG_INPUT_MISC=y
CONFIG_INPUT_UINPUT=y
CONFIG_INPUT_GPIO=y
CONFIG_INPUT_HALL=y
CONFIG_TTY=y
CONFIG_UNIX98_PTYS=y
CONFIG_SERIAL_SAMSUNG=y
CONFIG_SERIAL_SAMSUNG_UARTS=4
CONFIG_SERIAL_SAMSUNG_CONSOLE=y
CONFIG_HW_RANDOM=y
CONFIG_HW_RANDOM_EXYNOS_SWD=y
CONFIG_I2C=y
CONFIG_I2C_CHARDEV=y
CONFIG_I2C_EXYNOS5=y
CONFIG_I2C_GPIO=y
CONFIG_I2C_S3C2410=y
CONFIG_SPI=y
CONFIG_SPI_S3C64XX=y
CONFIG_PINCTRL=y
CONFIG_PINCTRL_SAMSUNG=y
CONFIG_PINCTRL_EXYNOS=y
CONFIG_GPIOLIB=y
CONFIG_GPIO_SYSFS=y
CONFIG_SEC_GPIO_DVS=y
CONFIG_POWER_SUPPLY=y
CONFIG_MFD_CORE=y
CONFIG_MFD_SM5703=y
CONFIG_MFD_SEC_CORE=y
CONFIG_MFD_S2MU003=y
CONFIG_REGULATOR=y
CONFIG_REGULATOR_FIXED_VOLTAGE=y
CONFIG_REGULATOR_S2MPU04=y
CONFIG_REGULATOR_S2MU003=y
CONFIG_REGULATOR_SM5703=y
CONFIG_MEDIA_SUPPORT=y
CONFIG_MEDIA_CAMERA_SUPPORT=y
CONFIG_VIDEO_DEV=y
CONFIG_VIDEO_V4L2=y
CONFIG_VIDEOBUF2_ION=y
CONFIG_VIDEO_EXYNOS=y
CONFIG_VIDEO_EXYNOS_MFC=y
CONFIG_VIDEO_EXYNOS_FIMC_IS=y
CONFIG_CAMERA_CIS_SELECT=y
CONFIG_CAMERA_CIS_5E3_OBJ=y
CONFIG_CAMERA_CIS_4H5YC_OBJ=y
CONFIG_CAMERA_ACT_SELECT=y
CONFIG_CAMERA_ACT_ZC533_OBJ=y
CONFIG_CAMERA_FLASH_SELECT=y
CONFIG_CAMERA_FLASH_GPIO_OBJ=y
CONFIG_FIMC_IS_V3_10_0=y
CONFIG_CAMERA_O5LTE=y
CONFIG_VIDEO_EXYNOS_SCALER=y
CONFIG_MALI_T7XX=y
CONFIG_MALI_MIDGARD=y
CONFIG_MALI_PLATFORM_THIRDPARTY=y
CONFIG_MALI_PLATFORM_THIRDPARTY_NAME="exynos"
CONFIG_MALI_DVFS=y
CONFIG_MALI_RT_PM=y
CONFIG_MALI_DEBUG_SYS=y
CONFIG_EXYNOS_SOC_NAME="3475"
CONFIG_FB=y
CONFIG_EXYNOS_VIDEO=y
CONFIG_EXYNOS_MIPI_DSI=y
CONFIG_EXYNOS_DECON_EXYNOS3475=y
CONFIG_EXYNOS3475_DISPLAY_VIDEO_MODE=y
CONFIG_EXYNOS_DECON_FB=y
CONFIG_EXYNOS3475_DECON_DISP_LCD=y
CONFIG_EXYNOS3475_DECON_DISP_LCD_NAME="ili9881c"
CONFIG_EXYNOS3475_DECON_LCD_ILI9881C=y
CONFIG_BACKLIGHT_CLASS_DEVICE=y
CONFIG_LCD_CLASS_DEVICE=y
CONFIG_SOUND=y
CONFIG_SND=y
CONFIG_SND_SOC=y
CONFIG_SND_SOC_SAMSUNG=y
CONFIG_SND_SAMSUNG_I2S=y
CONFIG_SND_SOC_SAMSUNG_UNIVERSAL3475_COD3025X=y
CONFIG_SND_SOC_COD3025X=y
CONFIG_SND_SOC_SRC2803X=y
CONFIG_SND_SOC_DUMMY_CODEC=y
CONFIG_USB_SUPPORT=y
CONFIG_USB=y
CONFIG_USB_EHCI_HCD=y
CONFIG_USB_EHCI_S5P=y
CONFIG_USB_OHCI_HCD=y
CONFIG_USB_OHCI_EXYNOS=y
CONFIG_USB_STORAGE=y
CONFIG_USB_G_ANDROID=y
CONFIG_USB_ANDROID_SAMSUNG_COMPOSITE=y
CONFIG_USB_PHY=y
CONFIG_SAMSUNG_USBPHY=y
CONFIG_SAMSUNG_DWC_USB2PHY=y
CONFIG_MMC=y
CONFIG_MMC_BLOCK=y
CONFIG_MMC_DW=y
CONFIG_MMC_DW_IDMAC=y
CONFIG_MMC_DW_EXYNOS=y
CONFIG_FMP=y
CONFIG_LEDS_CLASS=y
CONFIG_LEDS_KTD2026=y
CONFIG_FLED_SM5703=y
CONFIG_SWITCH=y
CONFIG_RTC_CLASS=y
CONFIG_RTC_DRV_SEC=y
CONFIG_DMADEVICES=y
CONFIG_PL330_DMA=y
CONFIG_ANDROID=y
CONFIG_ANDROID_BINDER_IPC=y
CONFIG_ASHMEM=y
CONFIG_ANDROID_LOW_MEMORY_KILLER=y
CONFIG_ANDROID_TIMED_OUTPUT=y
CONFIG_SYNC=y
CONFIG_ION=y
CONFIG_ION_EXYNOS=y
CONFIG_SEC_EXT=y
CONFIG_SEC_SYSFS=y
CONFIG_SEC_REBOOT=y
CONFIG_SEC_BSP=y
CONFIG_SEC_DEBUG=y
CONFIG_SEC_PM=y
CONFIG_ARGOS=y
CONFIG_THERMAL=y
CONFIG_THERMAL_HWMON=y
CONFIG_EXYNOS_THERMAL=y
CONFIG_EXYNOS_THERMAL_CORE=y
CONFIG_CPU_THERMAL=y
CONFIG_WATCHDOG=y
CONFIG_S3C2410_WATCHDOG=y
CONFIG_HWMON=y
CONFIG_SENSORS_SEC_THERMISTOR=y
CONFIG_SENSORS=y
CONFIG_SENSORS_CORE=y
CONFIG_SENSORS_K2HH=y
CONFIG_SENSORS_CM36672P=y
CONFIG_GPS_BCMxxxxx=y
CONFIG_GPS_BCM4752=y
CONFIG_SEC_VIB=y
CONFIG_BATTERY_SAMSUNG=y
CONFIG_BATTERY_SWELLING=y
CONFIG_FUELGAUGE_SM5703=y
CONFIG_CHARGER_SM5703=y
CONFIG_PREVENT_SOC_JUMP=y
CONFIG_MOBICORE_DRIVER=y
CONFIG_MOBICORE_API=y
CONFIG_SECURE_OS_CONTROL=y
CONFIG_TZ_ICCC=y
CONFIG_TIMA_LOG=y
CONFIG_UID_CPUTIME=y
CONFIG_VNSWAP=y
CONFIG_CLKSRC_EXYNOS_MCT=y
CONFIG_IOMMU_API=y
CONFIG_EXYNOS_IOMMU_V6=y
CONFIG_EXYNOS_IOVMM_V6=y
CONFIG_PM_DEVFREQ=y
CONFIG_DEVFREQ_GOV_SIMPLE_ONDEMAND=y
CONFIG_DEVFREQ_GOV_SIMPLE_EXYNOS=y
CONFIG_ARM_EXYNOS3475_BUS_DEVFREQ=y
CONFIG_EXYNOS_ADC=y
CONFIG_PWM=y
CONFIG_PWM_SAMSUNG=y
CONFIG_ARM_GIC=y
CONFIG_KNOX_KAP=y
CONFIG_KNOX_NCM=y
CONFIG_SEC_RESTRICT_ROOTING=y
CONFIG_SEC_RESTRICT_SETUID=y
CONFIG_EXYNOS_BUSMONITOR=y
CONFIG_EXYNOS_SNAPSHOT=y
CONFIG_PSTORE=y
CONFIG_EXT4_FS=y
CONFIG_VFAT_FS=y
CONFIG_SDCARD_FS=y
CONFIG_SDFAT_FS=y
CONFIG_EXFAT_FS=y
CONFIG_ECRYPT_FS=y
CONFIG_SDP=y
CONFIG_DLP=y
CONFIG_FUSE_FS=y
CONFIG_PROC_FS=y
CONFIG_TMPFS=y
CONFIG_SECURITY=y
CONFIG_SECURITY_SELINUX=y
CONFIG_KEYS=y
CONFIG_CRYPTO=y
CONFIG_CRYPTO_AES=y
CONFIG_CRYPTO_SHA1=y
CONFIG_CRYPTO_SHA256=y
CONFIG_CRYPTO_MD5=y
CONFIG_CRYPTO_DES=y
CONFIG_CRYPTO_ARC4=y
CONFIG_CRYPTO_TWOFISH=y
CONFIG_CRYPTO_CBC=y
CONFIG_CRYPTO_ECB=y
CONFIG_CRYPTO_DEFLATE=y
CONFIG_CRYPTO_LZO=y
CONFIG_DEBUG_FS=y
CONFIG_DEBUG_KERNEL=y
CONFIG_LOCKUP_DETECTOR=y
CONFIG_HARDLOCKUP_DETECTOR=y
CONFIG_MAGIC_SYSRQ=y
CONFIG_STACKTRACE=y
CONFIG_FRAME_POINTER=y
CONFIG_DEBUG_BUGVERBOSE=y
CONFIG_DEBUG_INFO=y
CONFIG_FTRACE=y
CONFIG_TRACING=y
```
